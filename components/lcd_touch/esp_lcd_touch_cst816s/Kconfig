## components/lcd_touch/esp_lcd_touch_cst816s/Kconfig
```kconfig
menu "ESP LCD TOUCH CST816S"

    config ESP_LCD_TOUCH_CST816S_USE_INTERRUPTS
        bool "Only read via I2C after interrupt"
        default "n"
        
endmenu
```

## components/lcd_touch/esp_lcd_touch_xpt2046/Kconfig.projbuild
```kconfig
menu "ESP LCD TOUCH XPT2046"
    config ESP_LCD_TOUCH_XPT2046_Z_NEEDED_FOR_TOUCH
        int "Z Pressure needed to register touch"
        default 128

    config ESP_LCD_TOUCH_XPT2046_Z_OVERSAMPLE_COUNT
        int "Number of times to oversample X&Y reads"
        default 4
endmenu
```
